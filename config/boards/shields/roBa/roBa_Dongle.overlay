#include "roBa.dtsi"

/ {
    kscan0: kscan {
        compatible = "zmk,kscan-mock";
        columns = <0>;
        rows = <0>;
        events = <0>;
    };
};

/*&roba_physical_layout {
    kscan = <&mock_kscan>;
};*/