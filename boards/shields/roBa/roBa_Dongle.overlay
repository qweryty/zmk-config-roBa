#include "roBa.dtsi"
#include "split_input_common.dtsi"

/ {
    kscan0: kscan {
        compatible = "zmk,kscan-mock";
        columns = <0>;
        rows = <0>;
        events = <0>;
    };
};

&trackball_roba_listener {
    status = "okay";
};

&trackball_ploopy_r_listener {
    status = "okay";
};
